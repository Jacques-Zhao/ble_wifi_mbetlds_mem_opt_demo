## sdkconfig.defaults
```kconfig
#
# Partition Table
#
CONFIG_PARTITION_TABLE_SINGLE_APP_LARGE=y"
# end of Partition Table

#
# Bluetooth
#
CONFIG_BT_ENABLED=y
CONFIG_BT_NIMBLE_ENABLED=y
CONFIG_BT_LE_SLEEP_ENABLE=y

#
# Wireless Coexistence
#
CONFIG_ESP_COEX_ENABLED=y
CONFIG_ESP_COEX_SW_COEXIST_ENABLE=y
# end of Wireless Coexistence

#
# Power Management
#
CONFIG_PM_ENABLE=y
# end of Power Management


#
# FreeRTOS
#
CONFIG_FREERTOS_USE_TICKLESS_IDLE=y
CONFIG_FREERTOS_IDLE_TIME_BEFORE_SLEEP=3
# end of FreeRTOS

#
# Main XTAL Config
#
CONFIG_XTAL_FREQ_26=y
CONFIG_XTAL_FREQ=26
# end of Main XTAL Config
```

## sdkconfig.defaults.opt.2
```kconfig
#
# Partition Table
#
CONFIG_PARTITION_TABLE_SINGLE_APP_LARGE=y"
# end of Partition Table

CONFIG_ESP_WIFI_SSID="HUAWEI_009"
CONFIG_ESP_WIFI_PASSWORD="12345678"

#
# Bluetooth
#
CONFIG_BT_ENABLED=y
CONFIG_BT_NIMBLE_ENABLED=y
CONFIG_BT_LE_SLEEP_ENABLE=y

#
# Wireless Coexistence
#
CONFIG_ESP_COEX_ENABLED=y
CONFIG_ESP_COEX_SW_COEXIST_ENABLE=y
# end of Wireless Coexistence

#
# Power Management
#
CONFIG_PM_ENABLE=y
# end of Power Management


#
# FreeRTOS
#
CONFIG_FREERTOS_USE_TICKLESS_IDLE=y
CONFIG_FREERTOS_IDLE_TIME_BEFORE_SLEEP=3
# end of FreeRTOS

#
# Main XTAL Config
#
CONFIG_XTAL_FREQ_26=y
CONFIG_XTAL_FREQ=26
# end of Main XTAL Config


# @@@@@@ Optimize based on IDF document @@@@@@@@@

#
# ESP Ringbuf
#
CONFIG_RINGBUF_PLACE_FUNCTIONS_INTO_FLASH=y
CONFIG_RINGBUF_PLACE_ISR_FUNCTIONS_INTO_FLASH=y
# end of ESP Ringbuf

#
# ESP Timer (High Resolution Timer)
#
CONFIG_ESP_TIMER_TASK_STACK_SIZE=2048
# end of ESP Timer (High Resolution Timer)

#
# Wi-Fi
#
CONFIG_ESP_WIFI_STATIC_RX_BUFFER_NUM=4
CONFIG_ESP_WIFI_DYNAMIC_RX_BUFFER_NUM=8
CONFIG_ESP_WIFI_DYNAMIC_TX_BUFFER=y
CONFIG_ESP_WIFI_DYNAMIC_TX_BUFFER_NUM=8

CONFIG_ESP_WIFI_AMPDU_TX_ENABLED=y
CONFIG_ESP_WIFI_TX_BA_WIN=6
CONFIG_ESP_WIFI_AMPDU_RX_ENABLED=y
CONFIG_ESP_WIFI_RX_BA_WIN=6
CONFIG_ESP_WIFI_IRAM_OPT=n
CONFIG_ESP_WIFI_RX_IRAM_OPT=n
CONFIG_ESP_WIFI_SLP_IRAM_OPT=n
CONFIG_ESP_WIFI_SOFTAP_SUPPORT=n

# end of Wi-Fi

#
# FreeRTOS
#

CONFIG_FREERTOS_IDLE_TASK_STACKSIZE=1160
CONFIG_FREERTOS_PLACE_FUNCTIONS_INTO_FLASH=y

# end of FreeRTOS

#
# LWIP
#
CONFIG_LWIP_TCPIP_TASK_STACK_SIZE=2048

#
# TCP
#
CONFIG_LWIP_TCP_SND_BUF_DEFAULT=4096
CONFIG_LWIP_TCP_WND_DEFAULT=5760
# end of TCP

# end of LWIP

#
# mbedTLS
#
CONFIG_MBEDTLS_DYNAMIC_BUFFER=y
CONFIG_MBEDTLS_DYNAMIC_FREE_CONFIG_DATA=y
CONFIG_MBEDTLS_DYNAMIC_FREE_CA_CERT=y

CONFIG_MBEDTLS_TLS_CLIENT_ONLY=y


#
# ESP-Driver:SPI Configurations
#
CONFIG_SPI_SLAVE_IN_IRAM=n
CONFIG_SPI_SLAVE_ISR_IN_IRAM=n
# end of ESP-Driver:SPI Configurations

#
# Newlib
#
CONFIG_LIBC_LOCKS_PLACE_IN_IRAM=n
CONFIG_NEWLIB_NANO_FORMAT=y
# end of Newlib

#
# ESP Ringbuf
#
CONFIG_RINGBUF_PLACE_FUNCTIONS_INTO_FLASH=y
# end of ESP Ringbuf

#
# Event Loop Library
#
CONFIG_ESP_EVENT_POST_FROM_ISR=n
CONFIG_ESP_EVENT_POST_FROM_IRAM_ISR=n
# end of Event Loop Library

#
# Hardware Abstraction Layer (HAL) and Low Level (LL)
#
CONFIG_HAL_ASSERTION_DISABLE=y
CONFIG_HAL_DEFAULT_ASSERTION_LEVEL=0
# end of Hardware Abstraction Layer (HAL) and Low Level (LL)

# @@@@@@ More in-depth optimization, ensure security @@@@@

#
# Compiler options
#
CONFIG_COMPILER_OPTIMIZATION_SIZE=y
CONFIG_COMPILER_SAVE_RESTORE_LIBCALLS=y
CONFIG_COMPILER_OPTIMIZATION_ASSERTIONS_DISABLE=y

# end of Compiler options

#
# Bluetooth
#

CONFIG_BT_CTRL_RUN_IN_FLASH_ONLY=y

#
# SPI Flash driver
#
CONFIG_SPI_FLASH_ROM_IMPL=n
CONFIG_SPI_FLASH_AUTO_SUSPEND=y
```

## sdkconfig.defaults.opt.3
```kconfig
#
# Partition Table
#
CONFIG_PARTITION_TABLE_SINGLE_APP_LARGE=y"
# end of Partition Table

#
# Bluetooth
#
CONFIG_BT_ENABLED=y
CONFIG_BT_NIMBLE_ENABLED=y
CONFIG_BT_LE_SLEEP_ENABLE=y

#
# Wireless Coexistence
#
CONFIG_ESP_COEX_ENABLED=y
CONFIG_ESP_COEX_SW_COEXIST_ENABLE=y
# end of Wireless Coexistence

#
# Power Management
#
CONFIG_PM_ENABLE=y
# end of Power Management


#
# FreeRTOS
#
CONFIG_FREERTOS_USE_TICKLESS_IDLE=y
CONFIG_FREERTOS_IDLE_TIME_BEFORE_SLEEP=3
# end of FreeRTOS

#
# Main XTAL Config
#
CONFIG_XTAL_FREQ_26=y
CONFIG_XTAL_FREQ=26
# end of Main XTAL Config


# @@@@@@ Optimize based on IDF document @@@@@@@@@

#
# ESP Ringbuf
#
CONFIG_RINGBUF_PLACE_FUNCTIONS_INTO_FLASH=y
CONFIG_RINGBUF_PLACE_ISR_FUNCTIONS_INTO_FLASH=y
# end of ESP Ringbuf

#
# ESP Timer (High Resolution Timer)
#
CONFIG_ESP_TIMER_TASK_STACK_SIZE=2048
# end of ESP Timer (High Resolution Timer)

#
# Wi-Fi
#
CONFIG_ESP_WIFI_STATIC_RX_BUFFER_NUM=4
CONFIG_ESP_WIFI_DYNAMIC_RX_BUFFER_NUM=8
CONFIG_ESP_WIFI_DYNAMIC_TX_BUFFER=y
CONFIG_ESP_WIFI_DYNAMIC_TX_BUFFER_NUM=8

CONFIG_ESP_WIFI_AMPDU_TX_ENABLED=y
CONFIG_ESP_WIFI_TX_BA_WIN=6
CONFIG_ESP_WIFI_AMPDU_RX_ENABLED=y
CONFIG_ESP_WIFI_RX_BA_WIN=6
CONFIG_ESP_WIFI_IRAM_OPT=n
CONFIG_ESP_WIFI_RX_IRAM_OPT=n
CONFIG_ESP_WIFI_SLP_IRAM_OPT=n
CONFIG_ESP_WIFI_SOFTAP_SUPPORT=n

# end of Wi-Fi

#
# FreeRTOS
#

CONFIG_FREERTOS_IDLE_TASK_STACKSIZE=1160
CONFIG_FREERTOS_PLACE_FUNCTIONS_INTO_FLASH=y

# end of FreeRTOS

#
# LWIP
#
CONFIG_LWIP_TCPIP_TASK_STACK_SIZE=2048

#
# TCP
#
CONFIG_LWIP_TCP_SND_BUF_DEFAULT=4096
CONFIG_LWIP_TCP_WND_DEFAULT=5760
# end of TCP

# end of LWIP

#
# mbedTLS
#
CONFIG_MBEDTLS_DYNAMIC_BUFFER=y
CONFIG_MBEDTLS_DYNAMIC_FREE_CONFIG_DATA=y
CONFIG_MBEDTLS_DYNAMIC_FREE_CA_CERT=y

CONFIG_MBEDTLS_TLS_CLIENT_ONLY=y


#
# ESP-Driver:SPI Configurations
#
CONFIG_SPI_SLAVE_IN_IRAM=n
CONFIG_SPI_SLAVE_ISR_IN_IRAM=n
# end of ESP-Driver:SPI Configurations

#
# Newlib
#
CONFIG_LIBC_LOCKS_PLACE_IN_IRAM=n
CONFIG_NEWLIB_NANO_FORMAT=y
# end of Newlib

#
# ESP Ringbuf
#
CONFIG_RINGBUF_PLACE_FUNCTIONS_INTO_FLASH=y
# end of ESP Ringbuf

#
# Event Loop Library
#
CONFIG_ESP_EVENT_POST_FROM_ISR=n
CONFIG_ESP_EVENT_POST_FROM_IRAM_ISR=n
# end of Event Loop Library

#
# Hardware Abstraction Layer (HAL) and Low Level (LL)
#
CONFIG_HAL_ASSERTION_DISABLE=y
CONFIG_HAL_DEFAULT_ASSERTION_LEVEL=0
# end of Hardware Abstraction Layer (HAL) and Low Level (LL)

# @@@@@@ Opt.2 More in-depth optimization, ensure security @@@@@

#
# Compiler options
#
CONFIG_COMPILER_OPTIMIZATION_SIZE=y
CONFIG_COMPILER_SAVE_RESTORE_LIBCALLS=y

# end of Compiler options

#
# Bluetooth
#

CONFIG_BT_CTRL_RUN_IN_FLASH_ONLY=y

#
# SPI Flash driver
#
CONFIG_SPI_FLASH_ROM_IMPL=n
CONFIG_SPI_FLASH_AUTO_SUSPEND=y

# @@@@@@ Opt.3 More in-depth optimization, v5.5+ only @@@@@

#
# PHY
#
CONFIG_ESP_PHY_IRAM_OPT=n

# end of PHY

#
# Power Management
#
CONFIG_PM_SLEEP_FUNC_IN_IRAM=n
CONFIG_PM_SLP_IRAM_OPT=n
CONFIG_PM_RTOS_IDLE_OPT=n
# end of Power Management

CONFIG_GPTIMER_ISR_HANDLER_IN_IRAM=n

CONFIG_ESP_WIFI_EXTRA_IRAM_OPT=n

CONFIG_SPI_MASTER_ISR_IN_IRAM=n
CONFIG_SPI_SLAVE_ISR_IN_IRAM=n
CONFIG_ESP_INTR_IN_IRAM=n
CONFIG_FREERTOS_PLACE_ISR_FUNCTIONS_INTO_FLASH=y

CONFIG_ESP_PERIPH_CTRL_FUNC_IN_IRAM=n
CONFIG_ESP_REGI2C_CTRL_FUNC_IN_IRAM=n

CONFIG_LOG_IN_IRAM=n
CONFIG_ROM_PRINT_IN_IRAM=n
CONFIG_ESP_TIMER_IN_IRAM=n

CONFIG_LIBC_MISC_IN_IRAM=n
CONFIG_SPI_FLASH_PLACE_FUNCTIONS_IN_IRAM=n

CONFIG_HEAP_PLACE_FUNCTION_INTO_FLASH=y
CONFIG_SPI_FLASH_BROWNOUT_RESET_XMC=n
CONFIG_COMPILER_OPTIMIZATION_ASSERTIONS_DISABLE=y

CONFIG_ESP32C2_REV_MIN_200=y
CONFIG_ESP32C2_REV_MIN_FULL=200
CONFIG_ESP_REV_MIN_FULL=200
```
